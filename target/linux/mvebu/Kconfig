## target/linux/mvebu/Kconfig
```kconfig
if LINUX_6_12

config LINUX_KCONFIG_OVERRIDE
	string
	default "arch/arm/configs/mvebu_defconfig" if TARGET_mvebu_generic
	default "arch/arm/configs/mv78xx0_defconfig" if TARGET_mvebu_cortexa9
	default "arch/arm/configs/armada_xp_defconfig" if TARGET_mvebu_cortexa72

endif

choice
	prompt "Marvell Armada XP Devices"
	default TARGET_DEVICE_mvebu_generic_DEVICE_lenovo_ix4-300d

	config TARGET_DEVICE_mvebu_generic_DEVICE_lenovo_ix4-300d
		bool "Lenovo Iomega ix4-300d"
		depends on TARGET_mvebu_generic

endchoice
```
